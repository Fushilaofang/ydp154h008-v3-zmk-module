## drivers/display/Kconfig
```kconfig
menuconfig DISPLAY
	bool "Display controller drivers"
	help
	  Enable display drivers

if DISPLAY

config DISPLAY_INIT_PRIORITY
	int "Display devices init priority"
	default 85
	help
	  Display devices initialization priority.

module = DISPLAY
module-str = display

rsource "Kconfig.st730x"

endif # DISPLAY
```
